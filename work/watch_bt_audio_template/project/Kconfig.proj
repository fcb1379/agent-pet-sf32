## work/watch_bt_audio_template/project/Kconfig.proj
```kconfig
#APP specific configuration.
config CUSTOM_MEM_MAP
    bool 
	select custom_mem_map
	default y if !SOC_SIMULATOR

config SOLUTION_ALLOC_MEM
    bool
    default y

config FREETYPE_TINY_FONT_FULL
    bool
    default y

config AGENT_PET_EXTERNAL_RESOURCES
    bool "Store GUI images and fonts in the file-system resource partition"
    depends on !BSP_USING_PC_SIMULATOR
    default y
    help
        Keep large LVGL images and the FreeType library out of main.bin.
        The initial fs_root image contains the complete resource set; later
        releases can transfer only files whose SHA-256 value changed.

config AGENT_PET_DISABLE_CLASSIC_BT_AUDIO
    bool "Disable classic Bluetooth audio for Agent Pet BLE image sync"
    default n
    help
        Keep the BLE services used by Agent Pet enabled, but do not start the
        A2DP/AVRCP sink. This avoids accessing classic Bluetooth persistence
        partitions on boards whose flash layout only provisions the BLE app.

config AGENT_PET_USING_IMU
    bool "Enable the Huangshan board LSM6-series six-axis IMU"
    depends on !BSP_USING_PC_SIMULATOR
    default y
    help
        Enable the I2C driver for the board-mounted LSM6DSL/LSM6DS3TR-C
        accelerometer and gyroscope. The PC simulator never builds this driver.

config AGENT_PET_USING_TF_CARD
    bool "Enable the Huangshan board SPI TF card and file manager"
    depends on !BSP_USING_PC_SIMULATOR
    select BSP_USING_SPI1
    select RT_USING_SPI_MSD
    default y
    help
        Enable the Huangshan board SPI1 TF card and PA27 card-detect input.
        The PC simulator never builds the TF driver or file-manager app.

config ENABLE_DFU
    bool "Enable SiFli NOR offline DFU sub-project"
    depends on !BSP_USING_PC_SIMULATOR
    default n
    help
        Build the SiFli DFU installer image used to install an
        offline_install.bin package received over BLE.

config FRAME_BUFFER_IN_PSRAM
    bool
    depends on BSP_USING_PSRAM

config WATCH_UI_DISABLE_EPIC_GPU
    bool "Disable EPIC GPU for watch UI"

menu "app cache Memory configuration"   

choice
    prompt "rotation image preferred cache memory"
    default  ROTATE_MEM_IN_PSRAM
    config ROTATE_MEM_IN_PSRAM
        depends on BSP_USING_PSRAM
        bool "PSRAM"
    config ROTATE_MEM_IN_SRAM
        bool "SRAM"
endchoice


choice
    prompt "freetype cache memory"
    default  FREETYPE_CACHE_IN_PSRAM
    config FREETYPE_CACHE_IN_PSRAM
        depends on BSP_USING_PSRAM
        bool "PSRAM"           
    config FREETYPE_CACHE_IN_SRAM_STANDALONE
        bool "SRAM STANDALONE"
    config FREETYPE_CACHE_IN_SRAM
        bool "SRAM(Share with system heap)"
endchoice


choice
    prompt "message preferred cache memory"
    default  MESSAGE_CACHE_IN_PSRAM
    config MESSAGE_CACHE_IN_PSRAM
        depends on BSP_USING_PSRAM
        bool "PSRAM"           
    config MESSAGE_CACHE_IN_SRAM_STANDALONE
        bool "SRAM STANDALONE"
    config MESSAGE_CACHE_IN_SRAM
         bool "SRAM(Share with system heap)"
endchoice


config IMAGE_CACHE_IN_PSRAM_SIZE
    int "image cache in psram size(standalone)"
    depends on BSP_USING_PSRAM
    default 2100000

config IMAGE_CACHE_IN_PSRAM_SIZE
    int
    depends on !BSP_USING_PSRAM
    default 0

config IMAGE_CACHE_IN_SRAM_SIZE
    int "image cache in sram size(standalone)"
    default 200000

    
config FT_CACHE_SIZE
    int "freetype cache size(bytes)"
    help 
        "Maximum freetype cache size(threshold), and define a standalon 
         array(size equals FT_CACHE_SIZE) if define 
         FREETYPE_CACHE_IN_PSRAM or FREETYPE_CACHE_IN_SRAM_STANDALONE"
    default 400000 if FREETYPE_CACHE_IN_PSRAM
    default 120000 if FREETYPE_CACHE_IN_SRAM_STANDALONE
    default 100000 if FREETYPE_CACHE_IN_SRAM


config MESSAGE_CACHE_SIZE
    int "message standalon cache size(bytes)"
    depends on MESSAGE_CACHE_IN_PSRAM || MESSAGE_CACHE_IN_SRAM_STANDALONE
    default 96000 if MESSAGE_CACHE_IN_PSRAM
    default 16000 if MESSAGE_CACHE_IN_SRAM_STANDALONE


endmenu
```
